## CMakeLists.txt
```
#
# Copyright (c) 2021 Nordic Semiconductor
#
# SPDX-License-Identifier: LicenseRef-Nordic-4-Clause
#

cmake_minimum_required(VERSION 3.20.0)
find_package(Zephyr REQUIRED HINTS $ENV{ZEPHYR_BASE})
project(fmna_crypto_test)

FILE(GLOB app_sources src/*.c)
target_sources(app PRIVATE ${app_sources})
zephyr_library_include_directories(${CMAKE_CURRENT_LIST_DIR}/../../src/crypto)
if(CONFIG_NORDIC_SECURITY_BACKEND)
  zephyr_library_link_libraries(mbedcrypto_oberon_imported)
else()
  zephyr_library_link_libraries(nrfxlib_crypto)
endif()
```

## prj.conf
```kconfig
#
# Copyright (c) 2021 Nordic Semiconductor
#
# SPDX-License-Identifier: LicenseRef-Nordic-4-Clause
#

CONFIG_ZTEST=y
CONFIG_ZTEST_NEW_API=y
CONFIG_ZTEST_SHUFFLE=y

CONFIG_ZTEST_STACK_SIZE=4096
CONFIG_REBOOT=y

# Enable FMN ADK
CONFIG_FMNA=y
CONFIG_FMNA_NORDIC_PRODUCT_PLAN=y

# Kernel dependent configuration required by FMN
CONFIG_HEAP_MEM_POOL_SIZE=4096
CONFIG_SYSTEM_WORKQUEUE_STACK_SIZE=4096
CONFIG_LINKER_ORPHAN_SECTION_PLACE=y
```

## src/main.c
```c
/*
 * Copyright (c) 2021 Nordic Semiconductor ASA
 *
 * SPDX-License-Identifier: LicenseRef-Nordic-4-Clause
 */

#include <zephyr/ztest.h>

ZTEST_SUITE(suite_fmn_crypto, NULL, NULL, NULL, NULL, NULL);
```

## src/test_collab.c
```c
/*
 * Copyright (c) 2021 Nordic Semiconductor ASA
 *
 * SPDX-License-Identifier: LicenseRef-Nordic-4-Clause
 */

#include <zephyr/ztest.h>

#include "fm_crypto.h"

/* A P-224 scalar. */
static const uint8_t d[28] = {
	0x00, 0x01, 0x02, 0x03, 0x04, 0x05, 0x06, 0x07,
	0x08, 0x09, 0x0a, 0x0b, 0x0c, 0x0d, 0x0e, 0x0f,
	0x10, 0x11, 0x12, 0x13, 0x14, 0x15, 0x16, 0x17,
	0x18, 0x19, 0x1a, 0x1b
};

/*
 * [SageMath]
 *  p224 = 2^224 - 2^96 + 1
 *  b224 = 18958286285566608000408668544493926415504680968679321075787234672564
 *
 *  gx = 0xb70e0cbd6bb4bf7f321390b94a03c1d356c21122343280d6115c1d21
 *  gy = 0xbd376388b5f723fb4c22dfe6cd4375a05a07476444d5819985007e34
 *
 *  d = 0x000102030405060708090a0b0c0d0e0f101112131415161718191a1b
 *
 *  FF = GF(p224)
 *  EC = EllipticCurve([FF(p224 - 3), FF(b224)])
 *  G = EC(FF(gx), FF(gy))
 *
 *  S = d*G
 *  hex(P[0]), hex(P[1])
 */
static const uint8_t S[57] = {
	0x04,
	0x0b, 0x75, 0x43, 0x51, 0x20, 0xc3, 0x61, 0x42,
	0x8b, 0xa8, 0xb6, 0xfa, 0x21, 0x9d, 0x65, 0xb7,
	0xdc, 0xd9, 0xb5, 0x13, 0x02, 0xd4, 0x00, 0x09,
	0xca, 0x7c, 0x6b, 0xba,
	0x15, 0x24, 0x09, 0x0e, 0xc8, 0x34, 0x48, 0xb4,
	0x1a, 0x21, 0x3e, 0x93, 0xd0, 0xee, 0x7b, 0x94,
	0xba, 0x15, 0xfa, 0x49, 0xaf, 0xf3, 0xf6, 0x88,
	0x63, 0xb1, 0xff, 0x4b
};

// Python: os.urandom(32)
static const byte R1[32] = {
	0x45, 0xc9, 0xec, 0xf9, 0xa9, 0xf8, 0x40, 0x8e,
	0xd0, 0xbd, 0x6f, 0xd4, 0x03, 0x7e, 0xaf, 0x2f,
	0xb6, 0x7f, 0xbe, 0x3f, 0x31, 0xe7, 0x4e, 0xa9,
	0x79, 0x35, 0x8e, 0x74, 0x06, 0x92, 0x57, 0x36
};

/*
 * [Python]
 * >>> import hashlib
 * >>> m = hashlib.sha256()
 * >>> m.update("000102030405060708090a0b0c0d0e0f101112131415161718191a1b".decode("hex"))
 * >>> m.update("45c9ecf9a9f8408ed0bd6fd4037eaf2fb67fbe3f31e74ea979358e7406925736".decode("hex"))
 * >>> m.hexdigest()
 * 'b7fbcfeba634d4b09e915a31e3daf4685e3d89c31ade6fdd2ac37ff3125764ae'
 */
static const byte C1[32] = {
	0xb7, 0xfb, 0xcf, 0xeb, 0xa6, 0x34, 0xd4, 0xb0,
	0x9e, 0x91, 0x5a, 0x31, 0xe3, 0xda, 0xf4, 0x68,
	0x5e, 0x3d, 0x89, 0xc3, 0x1a, 0xde, 0x6f, 0xdd,
	0x2a, 0xc3, 0x7f, 0xf3, 0x12, 0x57, 0x64, 0xae
};

/*
 * [SageMath]
 *  p224 = 2^224 - 2^96 + 1
 *  b224 = 18958286285566608000408668544493926415504680968679321075787234672564
 *
 *  gx = 0xb70e0cbd6bb4bf7f321390b94a03c1d356c21122343280d6115c1d21
 *  gy = 0xbd376388b5f723fb4c22dfe6cd4375a05a07476444d5819985007e34
 *
 *  d = 0x4eb94e8e7107777a1bf4109c10426de179944e2bf6753040d009cf90
 *
 *  FF = GF(p224)
 *  EC = EllipticCurve([FF(p224 - 3), FF(b224)])
 *  G = EC(FF(gx), FF(gy))
 *
 *  P = d*G
 *  hex(P[0]), hex(P[1])
 */
static const byte C2[89] = {
	0x04,
	0xcf, 0x04, 0x96, 0x2f, 0xf4, 0x9b, 0xac, 0x9c,
	0x8d, 0x8e, 0x8a, 0x73, 0x42, 0xfe, 0xc3, 0x0d,
	0x49, 0x0b, 0x89, 0xff, 0xc2, 0x5e, 0xe4, 0x5d,
	0x0a, 0xfc, 0x55, 0x01,
	0xe0, 0x76, 0x53, 0x1e, 0x80, 0x16, 0x0f, 0x60,
	0xc0, 0x3c, 0x06, 0x99, 0x8d, 0xbd, 0xda, 0x60,
	0x17, 0xb5, 0x64, 0x76, 0xf8, 0x30, 0xae, 0xba,
	0xd5, 0x42, 0x7f, 0x49,
	// r' = os.urandom(32)
	0x00, 0x6b, 0x03, 0xeb, 0xf6, 0xeb, 0x78, 0xc4,
	0x2b, 0x3a, 0x5e, 0x69, 0x74, 0xd1, 0x60, 0xa7,
	0x7b, 0x6f, 0x3f, 0xa7, 0x00, 0xd3, 0x1e, 0xcb,
	0x87, 0x43, 0xa2, 0xa4, 0xa5, 0x2a, 0xfc, 0xcc
};

// Same as above, with a point not on the curve.
static const byte C2_invalid[89] = {
	0x04,
	0xcf, 0x04, 0x96, 0x2f, 0xf4, 0x9b, 0xac, 0x9d,
	0x8d, 0x8e, 0x8a, 0x73, 0x42, 0xfe, 0xc3, 0x0d,
	0x49, 0x0b, 0x89, 0xff, 0xc2, 0x5e, 0xe4, 0x5d,
	0x0a, 0xfc, 0x55, 0x01,
	0xe0, 0x76, 0x53, 0x1e, 0x80, 0x16, 0x0f, 0x60,
	0xc0, 0x3c, 0x06, 0x99, 0x8d, 0xbd, 0xda, 0x60,
	0x17, 0xb5, 0x64, 0x76, 0xf8, 0x30, 0xae, 0xba,
	0xd5, 0x42, 0x7f, 0x49,
	// r' = os.urandom(32)
	0x00, 0x6b, 0x03, 0xeb, 0xf6, 0xeb, 0x78, 0xc4,
	0x2b, 0x3a, 0x5e, 0x69, 0x74, 0xd1, 0x60, 0xa7,
	0x7b, 0x6f, 0x3f, 0xa7, 0x00, 0xd3, 0x1e, 0xcb,
	0x87, 0x43, 0xa2, 0xa4, 0xa5, 0x2a, 0xfc, 0xcc
};

static const byte C3[60] = {
	0x00, 0x01, 0x02, 0x03, 0x04, 0x05, 0x06, 0x07,
	0x08, 0x09, 0x0a, 0x0b, 0x0c, 0x0d, 0x0e, 0x0f,
	0x10, 0x11, 0x12, 0x13, 0x14, 0x15, 0x16, 0x17,
	0x18, 0x19, 0x1a, 0x1b,
	0x45, 0xc9, 0xec, 0xf9, 0xa9, 0xf8, 0x40, 0x8e,
	0xd0, 0xbd, 0x6f, 0xd4, 0x03, 0x7e, 0xaf, 0x2f,
	0xb6, 0x7f, 0xbe, 0x3f, 0x31, 0xe7, 0x4e, 0xa9,
	0x79, 0x35, 0x8e, 0x74, 0x06, 0x92, 0x57, 0x36
};

/*
 * [SageMath]
 *  p224 = 2^224 - 2^96 + 1
 *  b224 = 18958286285566608000408668544493926415504680968679321075787234672564
 *
 *  gx = 0xb70e0cbd6bb4bf7f321390b94a03c1d356c21122343280d6115c1d21
 *  gy = 0xbd376388b5f723fb4c22dfe6cd4375a05a07476444d5819985007e34
 *
 *  d = 0x000102030405060708090a0b0c0d0e0f101112131415161718191a1b
 *  k = 0x4eb94e8e7107777a1bf4109c10426de179944e2bf6753040d009cf90
 *
 *  FF = GF(p224)
 *  EC = EllipticCurve([FF(p224 - 3), FF(b224)])
 *  G = EC(FF(gx), FF(gy))
 *
 *  P = d*G + k*G
 *  hex(P[0]), hex(P[1])
 */
static const byte P[57] = {
	0x04,
	0x40, 0x57, 0xa0, 0x95, 0xab, 0x90, 0x2e, 0xe0,
	0x21, 0x96, 0x15, 0x80, 0xe1, 0xc1, 0xf7, 0x4d,
	0xea, 0xa6, 0xe7, 0x3b, 0x51, 0xdd, 0x6f, 0x53,
	0x0a, 0x31, 0x4f, 0xc4,
	0x5e, 0x17, 0xc5, 0x8c, 0x04, 0x94, 0x51, 0x98,
	0x17, 0xb6, 0x92, 0x7c, 0xa6, 0x27, 0x88, 0x8e,
	0x20, 0x2a, 0xc2, 0xc3, 0x51, 0x37, 0xd7, 0xb6,
	0x69, 0x5e, 0xe7, 0x7f
};

/*
 * [Python]
 * >>> import hashlib
 * >>> m = hashlib.sha256()
 * >>> m.update("4057a095ab902ee021961580e1c1f74deaa6e73b51dd6f530a314fc4".decode("hex"))
 * >>> m.update("00000001".decode("hex"))
 * >>> m.update("45c9ecf9a9f8408ed0bd6fd4037eaf2fb67fbe3f31e74ea979358e7406925736".decode("hex"))
 * >>> m.update("006b03ebf6eb78c42b3a5e6974d160a77b6f3fa700d31ecb8743a2a4a52afccc".decode("hex"))
 * >>> m.hexdigest()
 * 'b7d9a36a1e8b40dcf1945286f126b14fd9f9a17a14f5d2047f5a3f23545051a2'
 *
 * >>> import hashlib
 * >>> m = hashlib.sha256()
 * >>> m.update("4057a095ab902ee021961580e1c1f74deaa6e73b51dd6f530a314fc4".decode("hex"))
 * >>> m.update("00000002".decode("hex"))
 * >>> m.update("45c9ecf9a9f8408ed0bd6fd4037eaf2fb67fbe3f31e74ea979358e7406925736".decode("hex"))
 * >>> m.update("006b03ebf6eb78c42b3a5e6974d160a77b6f3fa700d31ecb8743a2a4a52afccc".decode("hex"))
 * >>> m.hexdigest()
 * '2717ae9bd251c25bf5992808e41d8ddbaed6dd7e17d0f4cd577f3cd4adc92069'
 */
static const byte SKN[32] = {
	0xb7, 0xd9, 0xa3, 0x6a, 0x1e, 0x8b, 0x40, 0xdc,
	0xf1, 0x94, 0x52, 0x86, 0xf1, 0x26, 0xb1, 0x4f,
	0xd9, 0xf9, 0xa1, 0x7a, 0x14, 0xf5, 0xd2, 0x04,
	0x7f, 0x5a, 0x3f, 0x23, 0x54, 0x50, 0x51, 0xa2
};
static const byte SKS[32] = {
	0x27, 0x17, 0xae, 0x9b, 0xd2, 0x51, 0xc2, 0x5b,
	0xf5, 0x99, 0x28, 0x08, 0xe4, 0x1d, 0x8d, 0xdb,
	0xae, 0xd6, 0xdd, 0x7e, 0x17, 0xd0, 0xf4, 0xcd,
	0x57, 0x7f, 0x3c, 0xd4, 0xad, 0xc9, 0x20, 0x69
};

ZTEST(suite_fmn_crypto, test_collab)
{
	struct fm_crypto_ckg_context ckg_ctx;
	zassert_equal(fm_crypto_ckg_init(&ckg_ctx), 0, "");

	// Override random values with test vectors.
	memcpy(&ckg_ctx.key.private_key.buffer, d, 28);
	zassert_equal(ocrypto_sc_p224_from28bytes(
		&ckg_ctx.key.private_key.scalar_p224, d), 0, "");
	zassert_equal(ocrypto_curve_p224_from56bytes(
		&ckg_ctx.key.public_key.point_p224, S + 1), 0, "");
	memcpy(ckg_ctx.r1, R1, sizeof(R1));

	byte c1[32];
	zassert_equal(fm_crypto_ckg_gen_c1(&ckg_ctx, c1), 0, "");
	zassert_equal(memcmp(c1, C1, sizeof(C1)), 0, "");

	byte c3[60];
	/* Ensure that points not on the curve are rejected. */
	zassert_not_equal(fm_crypto_ckg_gen_c3(&ckg_ctx, C2_invalid, c3), 0, "");

	zassert_equal(fm_crypto_ckg_gen_c3(&ckg_ctx, C2, c3), 0, "");
	zassert_equal(memcmp(c3, C3, sizeof(C3)), 0, "");

	byte skn[32], sks[32], p[57];
	zassert_equal(fm_crypto_ckg_finish(&ckg_ctx, p, skn, sks), 0, "");
	zassert_equal(memcmp(p, P, sizeof(P)), 0, "");
	zassert_equal(memcmp(skn, SKN, sizeof(SKN)), 0, "");
	zassert_equal(memcmp(sks, SKS, sizeof(SKS)), 0, "");

	fm_crypto_ckg_free(&ckg_ctx);
}
```

## src/test_decrypt.c
```c
/*
 * Copyright (c) 2021 Nordic Semiconductor ASA
 *
 * SPDX-License-Identifier: LicenseRef-Nordic-4-Clause
 */

#include <zephyr/ztest.h>

#include "fm_crypto.h"

/* Random ServerSharedSecret. */
static const byte SERVER_SS[32] = {
	0x18, 0xfb, 0xa2, 0xc2, 0x5c, 0xb5, 0xea, 0x27,
	0x5d, 0x4b, 0xb0, 0x93, 0xea, 0x43, 0xe2, 0x26,
	0xe7, 0x31, 0x25, 0x03, 0x02, 0x9b, 0x8e, 0x93,
	0xc0, 0x56, 0x45, 0x6b, 0xfd, 0x0a, 0x14, 0xd8
};

/* Same as above, but one byte off. */
static const byte SERVER_SS_invalid[32] = {
	0x18, 0xfb, 0xa2, 0xc2, 0x5c, 0xb5, 0xea, 0x27,
	0x5d, 0x4b, 0xb0, 0x93, 0xea, 0x43, 0xe2, 0x26,
	0xe7, 0x31, 0x25, 0x03, 0x02, 0x9b, 0x8e, 0x93,
	0xc0, 0x56, 0x45, 0x6b, 0xfd, 0x0a, 0x14, 0xd9
};

/*
 * [Python]
 * >>> from Crypto.Cipher import AES
 * >>> k1 = "1afa481af19b6b8008a7b8bbbae69c0d".decode("hex")
 * >>> iv1 = "6674bbf4738ec84174903081b116d885".decode("hex")
 * >>> cipher = AES.new(k1, AES.MODE_GCM, nonce=iv1)
 * >>> ct, tag = cipher.encrypt_and_digest(b"sample")
 * >>> ct.encode('hex')
 * 'cfb396ab6eb7'
 * >>> tag.encode('hex')
 * '42a9f40c7ef5d57a4ff60f7efa52de54'
 */
static const byte E3[6 + 16] = {
	0xcf, 0xb3, 0x96, 0xab, 0x6e, 0xb7, 0x42, 0xa9,
	0xf4, 0x0c, 0x7e, 0xf5, 0xd5, 0x7a, 0x4f, 0xf6,
	0x0f, 0x7e, 0xfa, 0x52, 0xde, 0x54
};

/* Same as above, with an invalid tag. */
static const byte E3_invalid[6 + 16] = {
	0xcf, 0xb3, 0x96, 0xab, 0x6e, 0xb7, 0x42, 0xa9,
	0xf4, 0x0c, 0x7e, 0xf5, 0xd5, 0x7a, 0x4f, 0xf6,
	0x0f, 0x7e, 0xfa, 0x52, 0xde, 0x53
};

static const byte msg[] = "sample";

ZTEST(suite_fmn_crypto, test_decrypt)
{
	byte pt[sizeof(msg) - 1];
	word32 pt_len = sizeof(pt);

	/* Test decryption. */
	zassert_equal(fm_crypto_decrypt_e3(SERVER_SS, sizeof(E3), E3, &pt_len, pt), 0, "");
	zassert_equal(pt_len, sizeof(pt), "");

	/* Negative test vectors. */
	zassert_not_equal(fm_crypto_decrypt_e3(SERVER_SS_invalid, sizeof(E3), E3, &pt_len, pt), 0, "");
	zassert_not_equal(fm_crypto_decrypt_e3(SERVER_SS, sizeof(E3_invalid), E3_invalid, &pt_len, pt), 0, "");
}
```

## src/test_ecdsa.c
```c
/*
 * Copyright (c) 2021 Nordic Semiconductor ASA
 *
 * SPDX-License-Identifier: LicenseRef-Nordic-4-Clause
 */

#include <zephyr/ztest.h>

#include "fm_crypto.h"

/*
 * <https://tools.ietf.org/html/rfc6979#appendix-A.2.5>
 *
 * ECDSA signature with SHA-256, message = "sample".
 */
static const byte Q[65] = {
	0x04,
	0x60, 0xfe, 0xd4, 0xba, 0x25, 0x5a, 0x9d, 0x31,
	0xc9, 0x61, 0xeb, 0x74, 0xc6, 0x35, 0x6d, 0x68,
	0xc0, 0x49, 0xb8, 0x92, 0x3b, 0x61, 0xfa, 0x6c,
	0xe6, 0x69, 0x62, 0x2e, 0x60, 0xf2, 0x9f, 0xb6,
	0x79, 0x03, 0xfe, 0x10, 0x08, 0xb8, 0xbc, 0x99,
	0xa4, 0x1a, 0xe9, 0xe9, 0x56, 0x28, 0xbc, 0x64,
	0xf2, 0xf1, 0xb2, 0x0c, 0x2d, 0x7e, 0x9f, 0x51,
	0x77, 0xa3, 0xc2, 0x94, 0xd4, 0x46, 0x22, 0x99
};

/* Same as above, but one byte off. */
static const byte Q_invalid[65] = {
	0x04,
	0x60, 0xfe, 0xd4, 0xba, 0x25, 0x5a, 0x9d, 0x31,
	0xc9, 0x61, 0xeb, 0x74, 0xc6, 0x35, 0x6d, 0x68,
	0xc0, 0x49, 0xb8, 0x92, 0x3b, 0x61, 0xfa, 0x6c,
	0xe6, 0x69, 0x62, 0x2e, 0x60, 0xf2, 0x9f, 0xb6,
	0x79, 0x03, 0xfe, 0x10, 0x08, 0xb8, 0xbc, 0x99,
	0xa4, 0x1a, 0xe9, 0xe9, 0x56, 0x28, 0xbc, 0x64,
	0xf2, 0xf1, 0xb2, 0x0c, 0x2d, 0x7e, 0x9f, 0x51,
	0x77, 0xa3, 0xc2, 0x94, 0xd4, 0x46, 0x22, 0x98
};

static const byte sig[] = {
	0x30, 0x44, 0x02, 0x20,
	0xef, 0xd4, 0x8b, 0x2a, 0xac, 0xb6, 0xa8, 0xfd,
	0x11, 0x40, 0xdd, 0x9c, 0xd4, 0x5e, 0x81, 0xd6,
	0x9d, 0x2c, 0x87, 0x7b, 0x56, 0xaa, 0xf9, 0x91,
	0xc3, 0x4d, 0x0e, 0xa8, 0x4e, 0xaf, 0x37, 0x16,
	0x02, 0x20,
	0xf7, 0xcb, 0x1c, 0x94, 0x2d, 0x65, 0x7c, 0x41,
	0xd4, 0x36, 0xc7, 0xa1, 0xb6, 0xe2, 0x9f, 0x65,
	0xf3, 0xe9, 0x00, 0xdb, 0xb9, 0xaf, 0xf4, 0x06,
	0x4d, 0xc4, 0xab, 0x2f, 0x84, 0x3a, 0xcd, 0xa8
};

/* Same as above, one byte off. */
static const byte sig_invalid[] = {
	0x30, 0x44, 0x02, 0x20,
	0xef, 0xd4, 0x8b, 0x2a, 0xac, 0xb6, 0xa8, 0xfd,
	0x11, 0x40, 0xdd, 0x9c, 0xd4, 0x5e, 0x81, 0xd6,
	0x9d, 0x2c, 0x87, 0x7b, 0x56, 0xaa, 0xf9, 0x91,
	0xc3, 0x4d, 0x0e, 0xa8, 0x4e, 0xaf, 0x37, 0x16,
	0x02, 0x20,
	0xf7, 0xcb, 0x1c, 0x94, 0x2d, 0x65, 0x7c, 0x41,
	0xd4, 0x36, 0xc7, 0xa1, 0xb6, 0xe2, 0x9f, 0x65,
	0xf3, 0xe9, 0x00, 0xdb, 0xb9, 0xaf, 0xf4, 0x06,
	0x4d, 0xc4, 0xab, 0x2f, 0x84, 0x3a, 0xcd, 0xa7
};

/* Same as above, one byte short. */
static const byte sig_short[] = {
	0x30, 0x44, 0x02, 0x20,
	0xef, 0xd4, 0x8b, 0x2a, 0xac, 0xb6, 0xa8, 0xfd,
	0x11, 0x40, 0xdd, 0x9c, 0xd4, 0x5e, 0x81, 0xd6,
	0x9d, 0x2c, 0x87, 0x7b, 0x56, 0xaa, 0xf9, 0x91,
	0xc3, 0x4d, 0x0e, 0xa8, 0x4e, 0xaf, 0x37, 0x16,
	0x02, 0x20,
	0xf7, 0xcb, 0x1c, 0x94, 0x2d, 0x65, 0x7c, 0x41,
	0xd4, 0x36, 0xc7, 0xa1, 0xb6, 0xe2, 0x9f, 0x65,
	0xf3, 0xe9, 0x00, 0xdb, 0xb9, 0xaf, 0xf4, 0x06,
	0x4d, 0xc4, 0xab, 0x2f, 0x84, 0x3a, 0xcd
};

static const byte msg[] = "sample";

ZTEST(suite_fmn_crypto, test_ecdsa)
{
	zassert_equal(fm_crypto_verify_s2(Q, sizeof(sig), sig, sizeof(msg) - 1, msg), 0, "");

	/* Ensure that points not on the curve are rejected. */
	zassert_not_equal(fm_crypto_verify_s2(Q_invalid, sizeof(sig), sig, sizeof(msg) - 1, msg), 0, "");

	/* Negative test vectors. */
	zassert_not_equal(fm_crypto_verify_s2(Q, sizeof(sig_invalid), sig_invalid, sizeof(msg) - 1, msg), 0, "");
	zassert_not_equal(fm_crypto_verify_s2(Q, sizeof(sig_short), sig_short, sizeof(msg) - 1, msg), 0, "");
	zassert_not_equal(fm_crypto_verify_s2(Q, sizeof(sig), sig, sizeof(msg) - 2, msg), 0, "");
}
```

## src/test_ecies.c
```c
/*
 * Copyright (c) 2021 Nordic Semiconductor ASA
 *
 * SPDX-License-Identifier: LicenseRef-Nordic-4-Clause
 */

#include <zephyr/ztest.h>

#include <ocrypto_aes_gcm.h>
#include <ocrypto_ecdh_p256.h>

#include "fm_crypto.h"
#include "crypto_helper.h"

#define LOG_MODULE_NAME fmna_crypto_test_ecies
#include "crypto_log.h"

/*
 * <https://tools.ietf.org/html/rfc6979#appendix-A.2.5>
 */
static const byte d[32] = {
	0xc9, 0xaf, 0xa9, 0xd8, 0x45, 0xba, 0x75, 0x16,
	0x6b, 0x5c, 0x21, 0x57, 0x67, 0xb1, 0xd6, 0x93,
	0x4e, 0x50, 0xc3, 0xdb, 0x36, 0xe8, 0x9b, 0x12,
	0x7b, 0x8a, 0x62, 0x2b, 0x12, 0x0f, 0x67, 0x21
};

static const byte Q[65] = {
	0x04,
	0x60, 0xfe, 0xd4, 0xba, 0x25, 0x5a, 0x9d, 0x31,
	0xc9, 0x61, 0xeb, 0x74, 0xc6, 0x35, 0x6d, 0x68,
	0xc0, 0x49, 0xb8, 0x92, 0x3b, 0x61, 0xfa, 0x6c,
	0xe6, 0x69, 0x62, 0x2e, 0x60, 0xf2, 0x9f, 0xb6,
	0x79, 0x03, 0xfe, 0x10, 0x08, 0xb8, 0xbc, 0x99,
	0xa4, 0x1a, 0xe9, 0xe9, 0x56, 0x28, 0xbc, 0x64,
	0xf2, 0xf1, 0xb2, 0x0c, 0x2d, 0x7e, 0x9f, 0x51,
	0x77, 0xa3, 0xc2, 0x94, 0xd4, 0x46, 0x22, 0x99
};

/* Same as above, but one byte off. */
static const byte Q_invalid[65] = {
	0x04,
	0x60, 0xfe, 0xd4, 0xba, 0x25, 0x5a, 0x9d, 0x31,
	0xc9, 0x61, 0xeb, 0x74, 0xc6, 0x35, 0x6d, 0x68,
	0xc0, 0x49, 0xb8, 0x92, 0x3b, 0x61, 0xfa, 0x6c,
	0xe6, 0x69, 0x62, 0x2e, 0x60, 0xf2, 0x9f, 0xb6,
	0x79, 0x03, 0xfe, 0x10, 0x08, 0xb8, 0xbc, 0x99,
	0xa4, 0x1a, 0xe9, 0xe9, 0x56, 0x28, 0xbc, 0x64,
	0xf2, 0xf1, 0xb2, 0x0c, 0x2d, 0x7e, 0x9f, 0x51,
	0x77, 0xa3, 0xc2, 0x94, 0xd4, 0x46, 0x22, 0x98
};

static const byte msg[] = "sample";

#define CHECK_RV_RET(_rv_, _val_) if (_rv_) return _val_;
#define CHECK_RV(_rv_) CHECK_RV_RET(_rv_, _rv_);
#define CHECK_RV_GOTO(_rv_, _label_) if (_rv_) goto _label_;

/*! @function _fm_crypto_aes128gcm_decrypt
 @abstract Decrypts a ciphertext using AES-128-GCM.

 @param key       128-bit AES key.
 @param iv        128-bit IV.
 @param ct_nbytes Byte length of ciphertext.
 @param ct        Ciphertext.
 @param tag       128-bit authentication tag.
 @param out       Output buffer for the plaintext.

 @return 0 on success, a negative value on error.
 */
static int _fm_crypto_aes128gcm_decrypt(const byte key[16],
					const byte iv[16],
					word32 ct_nbytes,
					const byte *ct,
					const byte *tag,
					byte *out)
{
	int ret = FMN_ERROR_CRYPTO_NO_VALUE_SET;
	ocrypto_aes_gcm_ctx ctx = {0};

	LOG_DBG("_fm_crypto_aes128gcm_decrypt");
	/*
	* OpenSSL: EVP_DecryptInit_ex()
	* nrf_oberon: Not needed
	*/

	/*
	* OpenSSL: EVP_Decrypt*() + EVP_aes_128_gcm()
	*/
	LOG_HEXDUMP_DBG(tag, 16, "tag");
	LOG_HEXDUMP_DBG(ct, ct_nbytes, "ct");
	LOG_HEXDUMP_DBG(key, 16, "key");
	LOG_HEXDUMP_DBG(iv, 16, "iv");

	ocrypto_aes_gcm_init(&ctx, key, 16, iv);
	ocrypto_aes_gcm_init_iv(&ctx, iv, 16);

	ocrypto_aes_gcm_update_dec(&ctx, out, ct, ct_nbytes);
	ret = ocrypto_aes_gcm_final_dec(&ctx, tag, 16);

	LOG_HEXDUMP_DBG(out, ct_nbytes, "out");

	LOG_DBG("_fm_crypto_aes128gcm_decrypt result: 0x%X", ret);

	return ret;
}

int _fm_server_decrypt(word32 msg_nbytes,
		       const byte *msg,
		       word32 *out_nbytes,
		       byte *out)
{
	int rv;

	if (65 + 16 > msg_nbytes) {
		return -1;
	}

	if (*out_nbytes < msg_nbytes - 65 - 16) {
		return -1;
	}

	zassert_equal(msg[0], 0x04, "");

	/* Generate shared secret. */
	byte x[32];

	rv = ocrypto_ecdh_p256_common_secret(
		x,
		d,
		&msg[1]);
	zassert_equal(rv, 0, "");

	LOG_HEXDUMP_DBG(x, 32, "common_secret");

	/* Compute sharedinfo. */
	byte info[2 * 65];
	memcpy(info, msg, 65);
	memcpy(info + 65, Q, 65);

	/* Derive key and IV. */
	byte key_iv[32];

	rv = ansi_x963_kdf(
		(uint8_t*) &key_iv, 32,  /* derived key */
		x, 32,                   /* Z */
		info, sizeof(info));     /* sharedinfo */
		
	zassert_equal(rv, 0, "");

	LOG_HEXDUMP_DBG(key_iv, 16, "key");
	LOG_HEXDUMP_DBG(&key_iv[16], 16, "iv");

	/* Decrypt. */

	rv = _fm_crypto_aes128gcm_decrypt(
		key_iv,
		&key_iv[16],
		msg_nbytes - 65 - 16,
		msg + 65,
		msg + msg_nbytes - 16,
		out);
	zassert_equal(rv, 0, "");

	*out_nbytes = msg_nbytes - 65 - 16;

	return 0;
}

ZTEST(suite_fmn_crypto, test_ecies)
{
	byte ct[65 + sizeof(msg) - 1 + 16];
	word32 ct_len = sizeof(ct);

	/* Ensure that points not on the curve are rejected. */
	zassert_not_equal(fm_crypto_encrypt_to_server(Q_invalid, sizeof(msg) - 1, msg, &ct_len, ct), 0, "");

	zassert_equal(fm_crypto_encrypt_to_server(Q, sizeof(msg) - 1, msg, &ct_len, ct), 0, "");
	zassert_equal(ct_len, sizeof(ct), "");

	byte pt[sizeof(msg) - 1];
	word32 pt_len = sizeof(pt);
	zassert_equal(_fm_server_decrypt(sizeof(ct), ct, &pt_len, pt), 0, "");
	zassert_equal(pt_len, sizeof(msg) - 1, "");
	zassert_equal(memcmp(pt, msg, sizeof(msg) - 1), 0, "");
}
```

## src/test_keyroll.c
```c
/*
 * Copyright (c) 2021 Nordic Semiconductor ASA
 *
 * SPDX-License-Identifier: LicenseRef-Nordic-4-Clause
 */

#include <zephyr/ztest.h>

#include "fm_crypto.h"

/*
// A P-224 scalar. (Not known to the accessory.)
static const uint8_t d[28] = {
	0x00, 0x01, 0x02, 0x03, 0x04, 0x05, 0x06, 0x07,
	0x08, 0x09, 0x0a, 0x0b, 0x0c, 0x0d, 0x0e, 0x0f,
	0x10, 0x11, 0x12, 0x13, 0x14, 0x15, 0x16, 0x17,
	0x18, 0x19, 0x1a, 0x1b
};
*/

/*
 * [SageMath]
 *  p224 = 2^224 - 2^96 + 1
 *  b224 = 18958286285566608000408668544493926415504680968679321075787234672564
 *
 *  gx = 0xb70e0cbd6bb4bf7f321390b94a03c1d356c21122343280d6115c1d21
 *  gy = 0xbd376388b5f723fb4c22dfe6cd4375a05a07476444d5819985007e34
 *
 *  d = 0x000102030405060708090a0b0c0d0e0f101112131415161718191a1b
 *
 *  FF = GF(p224)
 *  EC = EllipticCurve([FF(p224 - 3), FF(b224)])
 *  G = EC(FF(gx), FF(gy))
 *
 *  P = d*G
 *  hex(P[0]), hex(P[1])
 */
static const uint8_t P[57] = {
	0x04,
	0x0b, 0x75, 0x43, 0x51, 0x20, 0xc3, 0x61, 0x42,
	0x8b, 0xa8, 0xb6, 0xfa, 0x21, 0x9d, 0x65, 0xb7,
	0xdc, 0xd9, 0xb5, 0x13, 0x02, 0xd4, 0x00, 0x09,
	0xca, 0x7c, 0x6b, 0xba,
	0x15, 0x24, 0x09, 0x0e, 0xc8, 0x34, 0x48, 0xb4,
	0x1a, 0x21, 0x3e, 0x93, 0xd0, 0xee, 0x7b, 0x94,
	0xba, 0x15, 0xfa, 0x49, 0xaf, 0xf3, 0xf6, 0x88,
	0x63, 0xb1, 0xff, 0x4b
};

/* Same as above, one byte off. */
static const uint8_t P_invalid[57] = {
	0x04,
	0x0b, 0x75, 0x43, 0x51, 0x20, 0xc3, 0x61, 0x42,
	0x8b, 0xa8, 0xb6, 0xfa, 0x21, 0x9d, 0x65, 0xb7,
	0xdc, 0xd9, 0xb5, 0x13, 0x02, 0xd4, 0x00, 0x09,
	0xca, 0x7c, 0x6b, 0xba,
	0x15, 0x24, 0x09, 0x0e, 0xc8, 0x34, 0x48, 0xb4,
	0x1a, 0x21, 0x3e, 0x93, 0xd0, 0xee, 0x7b, 0x94,
	0xba, 0x15, 0xfa, 0x49, 0xaf, 0xf3, 0xf6, 0x88,
	0x63, 0xb1, 0xff, 0x4c
};

/* A random SKN as generated by the Collaborative Key Generation protocol. */
static const uint8_t SKN_0[32] = {
	0xb9, 0xc6, 0xa6, 0xd7, 0x9a, 0x5f, 0x60, 0xce,
	0x9c, 0x3a, 0x0a, 0xf3, 0x8c, 0x80, 0x74, 0xdd,
	0x4f, 0x57, 0x8e, 0xca, 0xce, 0x6d, 0xd7, 0xc5,
	0xff, 0x92, 0x13, 0xb8, 0x35, 0x34, 0x6a, 0x73
};

/*
 * [Python]
 * >>> import hashlib
 * >>> m = hashlib.sha256()
 * >>> m.update("b9c6a6d79a5f60ce9c3a0af38c8074dd4f578ecace6dd7c5ff9213b835346a73".decode("hex"))
 * >>> m.update("00000001".decode("hex"))
 * >>> m.update(b"update")
 * >>> m.hexdigest()
 * '41c86f894c53a546d0f8f7f31bb4f91968f5102b6d8e74994fca9e042744bc3b'
 */
static const uint8_t SKN_1[32] = {
	0x41, 0xc8, 0x6f, 0x89, 0x4c, 0x53, 0xa5, 0x46,
	0xd0, 0xf8, 0xf7, 0xf3, 0x1b, 0xb4, 0xf9, 0x19,
	0x68, 0xf5, 0x10, 0x2b, 0x6d, 0x8e, 0x74, 0x99,
	0x4f, 0xca, 0x9e, 0x04, 0x27, 0x44, 0xbc, 0x3b
};

/*
 * [SageMath]
 *  p224 = 2^224 - 2^96 + 1
 *  b224 = 18958286285566608000408668544493926415504680968679321075787234672564
 *
 *  gx = 0xb70e0cbd6bb4bf7f321390b94a03c1d356c21122343280d6115c1d21
 *  gy = 0xbd376388b5f723fb4c22dfe6cd4375a05a07476444d5819985007e34
 *
 *  x = 0x0b75435120c361428ba8b6fa219d65b7dcd9b51302d40009ca7c6bba
 *  y = 0x1524090ec83448b41a213e93d0ee7b94ba15fa49aff3f68863b1ff4b
 *
 *  FF = GF(p224)
 *  EC = EllipticCurve([FF(p224 - 3), FF(b224)])
 *  G = EC(FF(gx), FF(gy))
 *  P = EC(FF(x), FF(y))
 *
 *  n = 0xffffffffffffffffffffffffffff16a2e0b8f03e13dd29455c5c2a3d
 *  u = (0x37c61399ea18a8bb2a34e290a8c1967d4e1e8f002eb87fbdac30dbeba86990fddca287c8 % (n - 1)) + 1
 *  v = (0x6bb6026aca217c4e1712dffe4fd9a38ccbb7081ad5c2a5f9ce3e4d096023fa3a731960da % (n - 1)) + 1
 *
 *  hex((u*P + v*G)[0])
 */
static const uint8_t x_P_1[28] = {
	0x3a, 0xcd, 0x35, 0x31, 0x34, 0x74, 0xf5, 0xbc,
	0x85, 0x17, 0x6e, 0x38, 0x52, 0x03, 0x30, 0x13,
	0xe1, 0x4c, 0x88, 0xc8, 0x8c, 0xe7, 0x3d, 0xcb,
	0xc9, 0xfb, 0x98, 0xf0
};

/*
 * [Python]
 * >>> import hashlib
 * >>> m = hashlib.sha256()
 * >>> m.update("41c86f894c53a546d0f8f7f31bb4f91968f5102b6d8e74994fca9e042744bc3b".decode("hex"))
 * >>> m.update("00000001".decode("hex"))
 * >>> m.update(b"update")
 * >>> m.hexdigest()
 * '2baa4520b786833621a7f9e806e0af2ee69370c3660188c1157e5203161b4067'
 */
static const uint8_t SKN_2[32] = {
	0x2b, 0xaa, 0x45, 0x20, 0xb7, 0x86, 0x83, 0x36,
	0x21, 0xa7, 0xf9, 0xe8, 0x06, 0xe0, 0xaf, 0x2e,
	0xe6, 0x93, 0x70, 0xc3, 0x66, 0x01, 0x88, 0xc1,
	0x15, 0x7e, 0x52, 0x03, 0x16, 0x1b, 0x40, 0x67
};

/*
 * [SageMath]
 *  p224 = 2^224 - 2^96 + 1
 *  b224 = 18958286285566608000408668544493926415504680968679321075787234672564
 *
 *  gx = 0xb70e0cbd6bb4bf7f321390b94a03c1d356c21122343280d6115c1d21
 *  gy = 0xbd376388b5f723fb4c22dfe6cd4375a05a07476444d5819985007e34
 *
 *  x = 0x0b75435120c361428ba8b6fa219d65b7dcd9b51302d40009ca7c6bba
 *  y = 0x1524090ec83448b41a213e93d0ee7b94ba15fa49aff3f68863b1ff4b
 *
 *  FF = GF(p224)
 *  EC = EllipticCurve([FF(p224 - 3), FF(b224)])
 *  G = EC(FF(gx), FF(gy))
 *  P = EC(FF(x), FF(y))
 *
 *  n = 0xffffffffffffffffffffffffffff16a2e0b8f03e13dd29455c5c2a3d
 *  u = (0x76ecd33667385b87456514189465887043ea6e0a6ce3b77fce0efda66b4b12a1889f7325 % (n - 1)) + 1
 *  v = (0xfb9e69fd9cc77a3459717b3be3e7409d1f7acc374545493b65bf26e462be44b91db96622 % (n - 1)) + 1
 *
 *  hex((u*P + v*G)[0])
 */
static const uint8_t x_P_2[28] = {
	0x51, 0x2d, 0xf1, 0x20, 0xc4, 0xc6, 0x0b, 0xc2,
	0xe2, 0x10, 0x0e, 0xbf, 0xc1, 0x87, 0x13, 0x89,
	0xa4, 0x2b, 0x2d, 0x6e, 0xc3, 0xab, 0x14, 0xab,
	0x16, 0xf4, 0xf9, 0x7c
};

/*
 * [Python]
 * >>> import hashlib
 * >>> m = hashlib.sha256()
 * >>> m.update("2c555e615836daa92b22b83f1874924d511f67b6886cd0c7d8f92ebf3b1ab4fe".decode("hex"))
 * >>> m.update("00000001".decode("hex"))
 * >>> m.update(b"connect")
 * >>> m.hexdigest()
 * '15363ee235ec43ac2180c30ff6b503cee6df09c1795fbf9b9874f9d923c71289'
 */
static const uint8_t LTK_1[16] = {
	0x15, 0x36, 0x3e, 0xe2, 0x35, 0xec, 0x43, 0xac,
	0x21, 0x80, 0xc3, 0x0f, 0xf6, 0xb5, 0x03, 0xce
};

/*
 * [Python]
 * >>> import hashlib
 * >>> m = hashlib.sha256()
 * >>> m.update("a63d617dfd864138f20dd41eb0c65b177e78cbdcef01dd9366201072bafd55a4".decode("hex"))
 * >>> m.update("00000001".decode("hex"))
 * >>> m.update(b"connect")
 * >>> m.hexdigest()
 * 'ebcf5bd3ed96a44eb236972f29279907520b73f08de0efd034904ee5805adf84'
 */
static const uint8_t LTK_2[16] = {
	0xeb, 0xcf, 0x5b, 0xd3, 0xed, 0x96, 0xa4, 0x4e,
	0xb2, 0x36, 0x97, 0x2f, 0x29, 0x27, 0x99, 0x07
};

ZTEST(suite_fmn_crypto, test_keyroll)
{
	byte skn1[32];
	zassert_equal(fm_crypto_roll_sk(SKN_0, skn1), 0, "");
	zassert_equal(memcmp(skn1, SKN_1, sizeof(SKN_1)), 0, "");

	byte skn2[32];
	zassert_equal(fm_crypto_roll_sk(skn1, skn2), 0, "");
	zassert_equal(memcmp(skn2, SKN_2, sizeof(SKN_2)), 0, "");

	byte p1x[28];
	zassert_equal(fm_crypto_derive_primary_or_secondary_x(skn1, P, p1x), 0, "");
	zassert_equal(memcmp(p1x, x_P_1, sizeof(x_P_1)), 0, "");

	byte p2x[28];
	zassert_equal(fm_crypto_derive_primary_or_secondary_x(skn2, P, p2x), 0, "");
	zassert_equal(memcmp(p2x, x_P_2, sizeof(x_P_2)), 0, "");

	byte ltk1[16];
	zassert_equal(fm_crypto_derive_ltk(skn1, ltk1), 0, "");
	zassert_equal(memcmp(ltk1, LTK_1, sizeof(LTK_1)), 0, "");

	byte ltk2[16];
	zassert_equal(fm_crypto_derive_ltk(skn2, ltk2), 0, "");
	zassert_equal(memcmp(ltk2, LTK_2, sizeof(LTK_2)), 0, "");

	/* Negative test vectors. */
	zassert_not_equal(fm_crypto_derive_primary_or_secondary_x(skn1, P_invalid, p1x), 0, "");
}
```

## src/test_ssecret.c
```c
/*
 * Copyright (c) 2021 Nordic Semiconductor ASA
 *
 * SPDX-License-Identifier: LicenseRef-Nordic-4-Clause
 */

#include <zephyr/ztest.h>

#include "fm_crypto.h"

/* Python: os.urandom(32) */
static const byte SEED_S[32] = {
	0x00, 0x6b, 0x03, 0xeb, 0xf6, 0xeb, 0x78, 0xc4,
	0x2b, 0x3a, 0x5e, 0x69, 0x74, 0xd1, 0x60, 0xa7,
	0x7b, 0x6f, 0x3f, 0xa7, 0x00, 0xd3, 0x1e, 0xcb,
	0x87, 0x43, 0xa2, 0xa4, 0xa5, 0x2a, 0xfc, 0xcc
};

/* Python: os.urandom(32) */
static const byte SEED_K1[32] = {
	0x45, 0xc9, 0xec, 0xf9, 0xa9, 0xf8, 0x40, 0x8e,
	0xd0, 0xbd, 0x6f, 0xd4, 0x03, 0x7e, 0xaf, 0x2f,
	0xb6, 0x7f, 0xbe, 0x3f, 0x31, 0xe7, 0x4e, 0xa9,
	0x79, 0x35, 0x8e, 0x74, 0x06, 0x92, 0x57, 0x36
};

/*
 * [Python]
 * >>> import hashlib
 * >>> m = hashlib.sha256()
 * >>> m.update("006b03ebf6eb78c42b3a5e6974d160a77b6f3fa700d31ecb8743a2a4a52afccc".decode("hex"))
 * >>> m.update("45c9ecf9a9f8408ed0bd6fd4037eaf2fb67fbe3f31e74ea979358e7406925736".decode("hex"))
 * >>> m.update("00000001".decode("hex"))
 * >>> m.update(b"ServerSharedSecret")
 * >>> m.hexdigest()
 * '18fba2c25cb5ea275d4bb093ea43e226e7312503029b8e93c056456bfd0a14d8'
 */
static const byte SERVER_SS[32] = {
	0x18, 0xfb, 0xa2, 0xc2, 0x5c, 0xb5, 0xea, 0x27,
	0x5d, 0x4b, 0xb0, 0x93, 0xea, 0x43, 0xe2, 0x26,
	0xe7, 0x31, 0x25, 0x03, 0x02, 0x9b, 0x8e, 0x93,
	0xc0, 0x56, 0x45, 0x6b, 0xfd, 0x0a, 0x14, 0xd8
};

static const byte msg[] = "sample";

/*
 * [Python]
 * >>> import hmac
 * >>> import hashlib
 * >>> ksn = "97167391b02522241964ef10804173926185f6712578ef797244683b93257a8b".decode("hex")
 * >>> h = hmac.new(ksn, b"sample", digestmod=hashlib.sha256)
 * >>> h.hexdigest()
 * '9943dafac34711542a7a58dfa219a8f08648749b0ea804b22b348d93b35a2332'
 */
static const byte MAC[32] = {
	0x99, 0x43, 0xda, 0xfa, 0xc3, 0x47, 0x11, 0x54,
	0x2a, 0x7a, 0x58, 0xdf, 0xa2, 0x19, 0xa8, 0xf0,
	0x86, 0x48, 0x74, 0x9b, 0x0e, 0xa8, 0x04, 0xb2,
	0x2b, 0x34, 0x8d, 0x93, 0xb3, 0x5a, 0x23, 0x32
};

ZTEST(suite_fmn_crypto, test_ssecret)
{
	byte serverss[32];
	zassert_equal(fm_crypto_derive_server_shared_secret(SEED_S, SEED_K1, serverss), 0, "");
	zassert_equal(memcmp(serverss, SERVER_SS, sizeof(SERVER_SS)), 0, "");

	byte mac[32];
	zassert_equal(fm_crypto_authenticate_with_ksn(serverss, sizeof(msg) - 1, msg, mac), 0, "");
	zassert_equal(memcmp(mac, MAC, sizeof(MAC)), 0, "");

	/* Test SeedK1 generation. */
	byte seedk1[32] = { 0 };
	zassert_equal(fm_crypto_generate_seedk1(seedk1), 0, "");

	byte acc = 0;
	for (int i = 0; i < sizeof(seedk1); acc |= seedk1[i++]);
	zassert_not_equal(acc, 0, "");
}
```
