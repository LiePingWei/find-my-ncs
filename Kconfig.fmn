## samples/qualification/sample.yaml
```yaml
sample:
  name: Find My Qualification
  description: Find My Qualification sample
tests:
  samples.qualification:
    build_only: true
    platform_allow: nrf52dk_nrf52832 nrf52833dk_nrf52833 nrf52840dk_nrf52840
      nrf5340dk_nrf5340_cpuapp nrf5340dk_nrf5340_cpuapp_ns
    integration_platforms:
      - nrf52dk_nrf52832
      - nrf52833dk_nrf52833
      - nrf52840dk_nrf52840
      - nrf5340dk_nrf5340_cpuapp
      - nrf5340dk_nrf5340_cpuapp_ns
    tags: ci_build
    extra_args: "CMAKE_BUILD_TYPE=ZRelease"
  samples.qualification.debug:
    build_only: true
    platform_allow: nrf52840dk_nrf52840 nrf5340dk_nrf5340_cpuapp nrf5340dk_nrf5340_cpuapp_ns
    integration_platforms:
      - nrf52840dk_nrf52840
      - nrf5340dk_nrf5340_cpuapp
      - nrf5340dk_nrf5340_cpuapp_ns
    tags: ci_build
```

## src/Kconfig
```kconfig
#
# Copyright (c) 2021 Nordic Semiconductor
#
# SPDX-License-Identifier: LicenseRef-Nordic-4-Clause
#

config FMNA
	bool "Enable FMN Accessory Development Kit"
	select BT
	select BT_PERIPHERAL
	select BT_SMP
	select BT_SMP_APP_PAIRING_ACCEPT
	select BT_EXT_ADV
	select BT_TPS

	select BT_SETTINGS
	select FLASH
	select FLASH_MAP
	select NVS
	select SETTINGS

	select APP_EVENT_MANAGER

	imply PM_SINGLE_IMAGE if !FMNA_UARP

if FMNA

config FMNA_CRYPTO
	bool
	default y
	select NRF_OBERON if FMNA_CRYPTO_ENTROPY_SRC && !NORDIC_SECURITY_BACKEND
	select OBERON_BACKEND if NORDIC_SECURITY_BACKEND
	select NORDIC_SECURITY_BACKEND if !FMNA_CRYPTO_ENTROPY_SRC

config FMNA_CRYPTO_ENTROPY_SRC
	bool
	default y if DT_HAS_NORDIC_NRF_RNG_ENABLED

config FMNA_QUALIFICATION
	bool "Enable qualification capabilities used by the FMCA app"
	select REBOOT

config FMNA_MAX_CONN
	int "Maximum number of FMN connections"
	default 2
	range 2 BT_MAX_CONN

config FMNA_TX_POWER
	int "TX power in dBm"
	help
	  TX power configuration in dBm used in advertising and connections.
	  Please note that the desired configuration may be different from the
	  actual one if a chosen HW platform does not support it. In this case,
	  the Find My stack displays a warning notifying the user about the
	  real TX power during the enabling procedure of this library. The
	  actual TX power value will be as close to the desired configuration
	  as possible.
	default 4
	range 4 8

config FMNA_BT_BOND_CLEAR
	bool "Clear Find My peers bond data during the enabling process"
	help
	  Clear bond data of the Find My peers in the Bluetooth stack during
	  the fmna_enable API call. All bonding information (keys, ccc, sc, cf)
	  related to the configured Find My identity are removed. This
	  configuration can be used to remove pollution of the settings area
	  with unused data that occured in certain edge cases in the past
	  nRF Connect SDK releases (v2.3.0 and all releases before that). This
	  option is disabled by default as it is not needed for the nRF Connect
	  SDK v2.4.0 release and beyond. In the newest firmware, the Find My
	  connection is no longer associated with any bonding information
	  and settings pollution should not happen.

config FMNA_CUSTOM_SERIAL_NUMBER
	bool "Use custom serial number from provisioned data"

config FMNA_SERVICE_HIDDEN_MODE
	bool "Hide the Find My services in the disabled state"
	select BT_GATT_SERVICE_CHANGED
	select BT_GATT_DYNAMIC_DB
	help
	  Have the FMN, AIS and Firmware Update services registered in the
	  Bluetooth GATT database only when the Find My stack is enabled.
	  In the disabled state, these services will not be visible to the
	  connected peers.

choice FMNA_LOG_MFI_AUTH_TOKEN_FORMAT
	prompt "Log MFi Authentication Token format"
	depends on LOG
	default FMNA_LOG_MFI_AUTH_TOKEN_BASE64_SHORT

config FMNA_LOG_MFI_AUTH_TOKEN_HEX_SHORT
	bool "Log first 16 bytes MFi Authentication Token in standard hex format"

config FMNA_LOG_MFI_AUTH_TOKEN_HEX_FULL
	bool "Log full MFi Authentication Token with trimmed trailing zeros in standard hex format"

config FMNA_LOG_MFI_AUTH_TOKEN_BASE64_SHORT
	bool "Log first and last 16 characters of MFi Authentication Token in Base64 encoded format"
	select BASE64

config FMNA_LOG_MFI_AUTH_TOKEN_BASE64_FULL
	bool "Log full MFi Authentication Token in Base64 encoded format"
	select BASE64

endchoice

# Product Plan configuration
config FMNA_NORDIC_PRODUCT_PLAN
	bool "Use Nordic Product Plan"

# Pairing mode configuration
config FMNA_PAIRING_MODE_TIMEOUT
	int "Timeout for the pairing mode in seconds"
	default 600
	help
	  Override the default timeout for the pairing mode. Please note
	  that changes to this configuration are highly discouraged since
	  the specification requires a 10-minute timeout (or 600 seconds).

	  Set this option to zero in case you do not want to use the Find My
	  stack timeout feature. In this case, you need to use the pairing mode
	  management APIs: fmna_pairing_mode_enter and fmna_pairing_mode_cancel
	  to implement your custom pairing mode policy.

config FMNA_PAIRING_MODE_AUTO_ENTER
	bool "Automatically enter the Find My pairing mode"
	default y
	help
	  Use this option to automatically enter the Find My pairing mode and
	  to start the pairing mode advertising when the FMN stack transitions
	  to the unpaired state. With this configuration option disabled, you
	  need to call the fmna_pairing_mode_enter API to enter the pairing
	  mode in the aforementioned scenarios. Having this option disabled
	  may become handy to implement more elaborate pairing mode policies
	  that require the user to take certain action before the pairing mode
	  is activated on the device (e.g. button press).

config FMNA_BT_PAIRING_NO_BONDING
	bool
	default y
	select BT_BONDABLE_PER_CONNECTION
	help
	  Set the bonding flags to "No Bonding" for the Bluetooth LE Just Works
	  pairing scheme that is the initial step of the complete Find My
	  pairing flow.
	  The "No Bonding" mode is especially important for the pair before use
	  accessories. These types of accessories usually bond using their main
	  Bluetooth application identity and prevent the Find My pairing flow
	  in the "Bonding" mode from succeeding. In this case, the Find My
	  pairing fails as the Zephyr Bluetooth Host cannot store more than one
	  bond for the same peer (identified by the Identity Address).

# AIS configuration
menu "Accessory Information Service (AIS)"

config FMNA_MANUFACTURER_NAME
	string "FMN Accessory Manufacturer Name"
	default "Manufacturer"

config FMNA_MODEL_NAME
	string "FMN Accessory Model Name"
	default "Model"

config FMNA_CATEGORY
	int "FMN Accessory Category"
	range 1 167
	default 128

config FMNA_CAPABILITY_PLAY_SOUND_ENABLED
	bool "FMN Accessory Capability: declare sound playing capability"

config FMNA_CAPABILITY_DETECT_MOTION_ENABLED
	depends on FMNA_CAPABILITY_PLAY_SOUND_ENABLED
	bool "FMN Accessory Capability: declare motion detecting capability"

config FMNA_CAPABILITY_NFC_SN_LOOKUP_ENABLED
	bool "FMN Accessory Capability: declare Serial Number NFC lookup capability"

config FMNA_CAPABILITY_BLE_SN_LOOKUP_ENABLED
	bool "FMN Accessory Capability: declare Serial Number BLE lookup capability"

config FMNA_CAPABILITY_FW_UPDATE_ENABLED
	bool "FMN Accessory Capability: declare Firmware Update Service capability"

choice FMNA_BATTERY_TYPE
	prompt "FMN Accessory battery type"
	default FMNA_BATTERY_TYPE_POWERED

config FMNA_BATTERY_TYPE_POWERED
	bool "Powered"

config FMNA_BATTERY_TYPE_NON_RECHARGEABLE
	bool "Non-rechargeable battery"

config FMNA_BATTERY_TYPE_RECHARGEABLE
	bool "Rechargeable battery"

endchoice

endmenu

# Battery Level thresholds
config FMNA_BATTERY_STATE_CRITICAL_THR
	int "Battery level threshold [%] for entering critical battery state"
	range 0 100
	default 10

config FMNA_BATTERY_STATE_LOW_THR
	int "Battery level threshold [%] for entering low battery state"
	range 0 100
	default 40

config FMNA_BATTERY_STATE_MEDIUM_THR
	int "Battery level threshold [%] for entering medium battery state"
	range 0 100
	default 80

# NFC configuration
config FMNA_NFC
	bool
	depends on FMNA_CAPABILITY_NFC_SN_LOOKUP_ENABLED
	default y
	select NFC_T2T_NRFXLIB
	select NFC_NDEF
	select NFC_NDEF_MSG
	select NFC_NDEF_RECORD
	select NFC_NDEF_URI_REC
	select NFC_NDEF_URI_MSG
	help
	  Enable NFC support.

if !FMNA_UARP

menu "Firmware version"

config FMNA_FIRMWARE_VERSION_MAJOR
	int "FMNA Firmware major version"
	default 1
	range 0 65535

config FMNA_FIRMWARE_VERSION_MINOR
	int "FMNA Firmware major version"
	default 0
	range 0 255

config FMNA_FIRMWARE_VERSION_REVISION
	int "FMNA Firmware revision version"
	default 0
	range 0 255

endmenu
endif # !FMNA_UARP

# Override default BLE configuration

config BT_DEVICE_NAME
	default "Nordic_FMN"

config BT_L2CAP_TX_MTU
	default 247

config BT_BUF_ACL_RX_SIZE
	default 251

config BT_BUF_ACL_TX_SIZE
	default 251

config BT_CTLR_DATA_LENGTH_MAX
	default 251

config BT_CTLR_TX_PWR_DYNAMIC_CONTROL
	default y

config BT_ID_MAX
	default 2

config BT_MAX_CONN
	default 2

config BT_MAX_PAIRED
	default FMNA_MAX_CONN

config BT_GATT_SERVICE_CHANGED
	default n

config BT_PERIPHERAL_PREF_TIMEOUT
	default 100

config BT_CONN_PARAM_UPDATE_TIMEOUT
	default 500

# Override default Settings configuration

config SETTINGS_DYNAMIC_HANDLERS
	default n

# Override default libc implementation choice

choice LIBC_IMPLEMENTATION
	default MINIMAL_LIBC
	help
	  Use minimal libc implementation to reduce memory footprint and prevent
	  build issues.
endchoice

rsource "uarp/Kconfig"

# Logger configuration

module = FMNA
module-str = FMNA
source "${ZEPHYR_BASE}/subsys/logging/Kconfig.template.log_config"

endif # FMNA
```

## src/uarp/Kconfig
```kconfig
#
# Copyright (c) 2021 Nordic Semiconductor
#
# SPDX-License-Identifier: LicenseRef-Nordic-4-Clause
#

config FMNA_UARP
	bool
	depends on FMNA_CAPABILITY_FW_UPDATE_ENABLED
	default y
	select BOOTLOADER_MCUBOOT
	select DFU_TARGET
	select DFU_TARGET_MCUBOOT
	select STREAM_FLASH
	select IMG_MANAGER
	select IMG_ERASE_PROGRESSIVELY
	select REBOOT
	help
	  Enable Unified Accessory Restore Protocol (UARP) for Firmware Updates.

if FMNA_UARP

menu "Unified Accessory Restore Protocol (UARP)"

config FMNA_HARDWARE_VERSION
	string "FMN Accessory Hardware Version"
	default "1"

config FMNA_UARP_PAYLOAD_4CC
	string "Payload 4CC Tag"
	default "FWUP"
	help
	  Payload 4CC Tag of a payload containing MCUboot image for FW update.
	  It must be 4 characters long. Payloads with different 4CC will be
	  ignored.

config FMNA_UARP_TX_MSG_PAYLOAD_SIZE
	int "TX message payload size"
	default 64
	range 24 256
	help
	  Maximum size of payload in a single outgoing UARP message. Entire
	  UARP outgoing message payload must fit into this buffer.
	  A minimum size is 24, but also each of the strings Manufacturer Name,
	  Model Name, Serial Number, Hardware Version plus 8 bytes must fit
	  into this payload.

config FMNA_UARP_RX_MSG_PAYLOAD_SIZE
	int "RX message payload size"
	default 208
	range 32 FMNA_UARP_PAYLOAD_WINDOW_SIZE
	help
	  Maximum size of payload in a single incoming UARP message. You can
	  calculate number of ATT packets per single messages during the asset
	  payload download using a formula:
	  N = round_up((FMNA_UARP_RX_MSG_PAYLOAD_SIZE + 18) / (ATT_MTU - 4)),
	  where ATT_MTU is MTU negotiated for a specific BLE connection.
	  On the other hand, if you want to divide payload evenly to the
	  N packets, you can use formula:
	  FMNA_UARP_RX_MSG_PAYLOAD_SIZE = N * (ATT_MTU - 4) - 18

config FMNA_UARP_PAYLOAD_WINDOW_SIZE
	int "Payload window size"
	default 1024
	range 256 8192
	help
	  Size of the window that will be used to store data requested from the
	  controller. Payload data will be divided into chunks of this size.
	  Metadata must be requested at once, so metadata of a single payload
	  or a SuperBinary cannot be bigger than this size.

config FMNA_UARP_MCUBOOT_BUF_SIZE
	int "Buffer size used for flash writes to MCUboot slot"
	default 512
	range 256 4096
	help
	  Buffer size needed for flash writes to MCUboot slot.

config FMNA_UARP_REBOOT_DELAY_TIME
	int "Reboot delay time"
	default 1000
	help
	  Reboot delay time after successfully update in milliseconds.

config FMNA_UARP_DEDICATED_THREAD
	bool "Use dedicated thread for UARP"
	help
	  Creates a new thread to handle UARP and associated flash operations.
	  It allows unloading system work queue and allow adjust thread priority
	  for UARP.

if FMNA_UARP_DEDICATED_THREAD

config FMNA_UARP_THREAD_STACK_SIZE
	int "Stack size for UARP thread"
	default 3072 if NO_OPTIMIZATIONS
	default 1536
	help
	  Stack size for dedicated UARP thread.

config FMNA_UARP_THREAD_PRIORITY
	int "Priority of UARP thread"
	default NUM_PREEMPT_PRIORITIES
	range 0 NUM_PREEMPT_PRIORITIES
	help
	  Priority of dedicated UARP thread.

endif # FMNA_UARP_DEDICATED_THREAD

config FMNA_UARP_TEST
	bool "Enable UARP Test mode"
	help
	  Enable UARP test mode. In the test mode firmware update can be done also by a non Owner
	  device. The new firmware confirmation is done on the application startup.
	  This should be enabled only for development purpose.

config FMNA_UARP_IMAGE_CONFIRMATION_ON_STARTUP
	bool "Confirm test image on startup" if !FMNA_UARP_TEST
	default y if FMNA_UARP_TEST
	help
	  Confirm MCUBoot test image on application startup. This can be enabled
	  only for development purpose. In production, the confirmation should
	  be done when the application actually seems to work properly.

menu "UARPDK Module"

config UARP_DISABLE_VENDOR_SPECIFIC
	bool "Disable Vendor Specific Messages"
	default y
	help
	  Disable handling of UARP Vendor Specific Messages.

config UARP_DISABLE_REQUIRE_LOGS
	bool "Disable 'Require' logs"
	help
	  Disable logging from __UARP_Require/Check/Verify family macros.

choice UARPDK_LOG_LEVEL_CHOICE
	default UARPDK_LOG_LEVEL_WRN
endchoice

config UARP_DISABLE_VERIFY
	bool "Disable 'Verify' macros"
	help
	  Disable __UARP_Verify family macros.

config UARP_ASSERT_ON_REQUIRE
	bool "Assert in 'Require' macros"
	help
	  Put __ASSERT_NO_MSG() macro in __UARP_Require macros family.

config UARP_ASSERT_ON_CHECK
	bool "Assert in 'Check' macros"
	help
	  Put __ASSERT_NO_MSG() macro in __UARP_Check macro.

config UARP_ASSERT_ON_VERIFY
	bool "Assert in 'Verify' macros"
	help
	  Put __ASSERT_NO_MSG() macro in __UARP_Verify macros family.

# Logger configuration for UARPDK module
module = UARPDK
module-str = UARPDK Module
source "${ZEPHYR_BASE}/subsys/logging/Kconfig.template.log_config"

endmenu # UARPDK Module

# Logger configuration for FMN UARP Service
module = FMNA_UARP
module-str = FMN UARP Service
source "${ZEPHYR_BASE}/subsys/logging/Kconfig.template.log_config"

endmenu
endif # FMNA_UARP
```

## west.yml
```yaml
# The west manifest file (west.yml) for the Find My Network (FMN) ADK.
#
# The per-workspace west configuration file, ncs/.west/config,
# specifies the location of this manifest file like this:
#
#     [manifest]
#     path = nrf
#
# See the west documentation for more information:
#
# https://developer.nordicsemi.com/nRF_Connect_SDK/doc/latest/zephyr/guides/west/index.html

manifest:
  # This west.yml requires west 0.7 or later, because the "import"
  # feature used below was introduced then.
  version: 0.7

  # "remotes" is a list of locations where git repositories are cloned
  # and fetched from.
  remotes:
    # nRF Connect SDK GitHub organization.
    # NCS repositories are hosted here.
    - name: ncs
      url-base: https://github.com/nrfconnect

  # If not otherwise specified, the projects below should be obtained
  # from the ncs remote.
  defaults:
    remote: ncs

  # "projects" is a list of git repositories which make up the NCS
  # source code.
  projects:

    # Import the nRF Connect SDK project.
    #
    # https://developer.nordicsemi.com/nRF_Connect_SDK/doc/latest/nrf/index.html
    - name: nrf
      repo-path: sdk-nrf
      revision: v1.5.0
      import: true


  # West-related configuration for the fmn repository.
  self:
    # This repository should be cloned to ncs/fmn.
    path: fmn
```
